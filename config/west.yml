## config/west.yml
```yaml
manifest:
  defaults:
    remote: urob
    revision: v0.3

  remotes:
    - name: urob
      url-base: https://github.com/urob
    - name: zmkfirmware
      url-base: https://github.com/zmkfirmware

  projects:
    - name: zmk
      remote: zmkfirmware
      revision: v0.3
      import: app/west.yml
  self:
    path: config
```
